#include <FlagPCM.h>
//FlagPCM is not available in the built in library function you'll have to download it directly from their github page.
#include <Dabble.h>\
/*Your bluetooth module     wiring is as follows: Vcc goes to 5v, GND goes to GND, Tx goes to 
    D2, and RX goes to D3. 
*/
#include <Servo.h>
#include <OneButton.h>

#define CUSTOM_SETTINGS
#define INCLUDE_GAMEPAD_MODULE

int vocalTimer = 0;


const unsigned char sample[] PROGMEM = {
129, 127, 128, 128, 128, 128, 128, 129, 127, 128, 127, 128,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 110, };

bool bluetoothMode = false;
//turned variable does not mean baby wall-e has become a zombie, its to keep track of one of the programmable functions specifically turnLook().
bool turned = false;
bool compartmentOpened = false;

//Left Motor
int dirPin1 = A0;
int dirPin2 = A1;
//Right Motor
int dirPin3 = A2;
int dirPin4 = A3;

int ledPin = A4;

int leftArm = 6;
int rightArm = 5;
int head = 7;
int compartment = 9;
int headTilt = 10;
int leftArmPos = 90;
int rightArmPos = 90;
int headPos = 90;
int compartmentPos = 15;
int headTiltPos = 90;

//Our one servo object that all servo movements will come from. Muhahaha Sneaky coding right there.
Servo adjustServo;

//We dont need a resistor for the button because we are using the built in pull-up resistor in the arduino
OneButton compartmentButton(A5, true, true);

//keeps track of our two random values.
int randNumber;
int randDelayNumber;

void setup() {
  Serial.begin(250000);
  Dabble.begin(9600);
  
  playback(sample, sizeof(sample));
  
  pinMode(dirPin1, OUTPUT);
  pinMode(dirPin2, OUTPUT);
  pinMode(dirPin3, OUTPUT);
  pinMode(dirPin4, OUTPUT);
  pinMode(ledPin, OUTPUT);

  compartmentButton.attachClick(singleClick);
  compartmentButton.attachLongPressStop(longClick);

  initServos();
//By pulling the value of of A6 which is an unused pin we are able to get a pretty much truly random number everytime 
  randomSeed(analogRead(A6));
  randDelayNumber = (random(0,5)*100);
}

void loop() {
if(batLvlGood())
{
  compartmentButton.tick();
  if(bluetoothMode)
  {
      bluetoothControl();
  }
  else
  {
    if(randDelayNumber == 0)
    {
    standby();
    randDelayNumber = (random(0,5)*700);
    }
    else
    {
      randDelayNumber--;//Might include a delay() if its to fast.
      Serial.println(randDelayNumber);
    }
    
  }
}
else{
  vocalTimer++;

  if(vocalTimer == 10000)
  {
    playback(sample, sizeof(sample));
    vocalTimer = 0;
  }
}
delay(10);
}

bool batLvlGood()
{
    int sensorValue = analogRead(A7);
    float voltage = sensorValue * (5.00 / 1023.00) *2;
    Serial.print("Voltage = ");
    Serial.println(voltage);
    if(voltage < 7.4)
    {
      digitalWrite(ledPin, HIGH);
      return false;
    }
    else
    {
      digitalWrite(ledPin, LOW);
      return true;
    }
}
void initServos()
{
  Serial.println("init servos");

  headPos = servoAdjust(head, 90 - headPos, headPos);   

  headTiltPos = servoAdjust(headTilt, 60 - headTiltPos, headTiltPos);   

  leftArmPos = servoAdjust(leftArm, 90 - leftArmPos, leftArmPos);
  rightArmPos = servoAdjust(rightArm, 90 - rightArmPos, rightArmPos);

  compartmentPos = servoAdjust(compartment, 15 - compartmentPos, compartmentPos);
  compartmentOpened = false;


  
  digitalWrite(ledPin, HIGH);
  delay(5);
  digitalWrite(ledPin, LOW);
    
}
void singleClick()
{
  Serial.println("SingleClick");
  if(!compartmentOpened)
  {
    Serial.println("Closing");
    compartmentPos = servoAdjust(compartment, 150, compartmentPos);
    Serial.println(compartmentPos);
    compartmentOpened = true;
  }
  else
  {
    Serial.println("opening");
    compartmentPos = servoAdjust(compartment, -150, compartmentPos);
    Serial.println(compartmentPos);
    compartmentOpened = false;
  }
  delay(500);
}
void longClick()
{
  Serial.print("Long Click");
  if(!bluetoothMode)
  {
    Serial.println("Enabling Bluetooth Controls");
    bluetoothMode = true;
    digitalWrite(ledPin, HIGH);
    delay(10);
    digitalWrite(ledPin, LOW);
  }
  else
  {
    Serial.println("Disabling Bluetooth Controls");
    bluetoothMode = false;  
    digitalWrite(ledPin, HIGH);
    delay(10);
    digitalWrite(ledPin, LOW);
  }
}
